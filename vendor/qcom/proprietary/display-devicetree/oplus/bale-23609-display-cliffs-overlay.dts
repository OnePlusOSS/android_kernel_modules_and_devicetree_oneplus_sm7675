/dts-v1/;
/plugin/;
#include <dt-bindings/oplus/hw-id.h>
#include "../display/cliffs-sde-display-mtp-overlay.dts"
#include "cliffs-display-overlay-common.dtsi"
#include "bale-23609-display-cliffs-overlay.dtsi"
/* #if defined(CONFIG_PXLW_IRIS) */
/* #endif */
/* #endif */

/ {
	model = "Qualcomm Technologies, Inc. Kalama MTP,bale";

	oplus,project-id = <23609 23678 23622 23718>;
};

/* #ifdef OPLUS_FEATURE_DISPLAY */
&mdss_dsi_phy0 {
	oplus,dsi-pll-ssc-disalbed;
};

&mdss_dsi_phy1 {
	oplus,dsi-pll-ssc-disalbed;
};
/* OPLUS_FEATURE_DISPLAY */
