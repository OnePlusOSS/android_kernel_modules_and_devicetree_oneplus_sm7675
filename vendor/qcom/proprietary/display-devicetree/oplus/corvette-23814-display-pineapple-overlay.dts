/dts-v1/;
/plugin/;
#include <dt-bindings/oplus/hw-id.h>
#include "../display/pineapple-sde-display-mtp-overlay.dts"
#include "pineapple-display-overlay-common.dtsi"
#include "corvette-23814-display-pineapple-overlay.dtsi"
/* #if defined(CONFIG_PXLW_IRIS) */
#include "pxlw-iris7p-pineapple-common.dtsi"
#include "pxlw-corvette/dsi-panel-pxlw-iris7p.dtsi"
/* #endif */

/ {
	model = "Qualcomm Technologies, Inc. Pineapple MTP,corvette";

	oplus,project-id = <23814>;
};
