/dts-v1/;
/plugin/;
#include <dt-bindings/oplus/hw-id.h>
#include "../display/pineapple-sde-display-mtp-overlay.dts"
#include "pineapple-display-overlay-common.dtsi"
#include "caihong-23926-display-pineapple-overlay.dtsi"

/ {
	model = "Qualcomm Technologies, Inc. Pineapple MTP,caihong";

	oplus,project-id = <23926 23927 23976 23978>;
};

&mdss_dsi_phy0 {
	oplus,dsi-pll-ssc-disalbed;
};

&mdss_dsi_phy1 {
	oplus,dsi-pll-ssc-disalbed;
};