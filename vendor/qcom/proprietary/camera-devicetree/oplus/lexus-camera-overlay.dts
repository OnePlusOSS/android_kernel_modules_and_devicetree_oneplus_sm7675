/dts-v1/;
/plugin/;

#include <dt-bindings/clock/qcom,gcc-cliffs.h>
#include <dt-bindings/clock/qcom,camcc-cliffs.h>
#include <dt-bindings/interconnect/qcom,cliffs.h>
#include <dt-bindings/interrupt-controller/arm-gic.h>
#include <dt-bindings/regulator/qcom,rpmh-regulator-levels.h>

#include <dt-bindings/oplus/hw-id.h>
#include "../cliffs-camera.dtsi"
#include "regulator/aw37004.dtsi"
#include "lexus_camera_overlay_common.dtsi"
/ {
	model = "Qualcomm Technologies, Inc. cliffs MTP,Lexus";
	compatible = "qcom,cliffs-mtp", "qcom,cliffs", "qcom,mtp";
	oplus,project-id = <24881 24882>;
};
