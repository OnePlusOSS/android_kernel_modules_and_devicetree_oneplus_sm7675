/dts-v1/;
/plugin/;

#include <dt-bindings/clock/qcom,gcc-pineapple.h>
#include <dt-bindings/clock/qcom,camcc-pineapple.h>
#include <dt-bindings/interconnect/qcom,pineapple.h>
#include <dt-bindings/interrupt-controller/arm-gic.h>
#include <dt-bindings/regulator/qcom,rpmh-regulator-levels.h>

#include <dt-bindings/oplus/hw-id.h>
#include "../pineapple-camera-v2.dtsi"
#include "corvette_camera_overlay_common.dtsi"
#include "corvette_camera_main_actuator_pid.dtsi"
/ {
	model = "Qualcomm Technologies, Inc. Corvette MTP";
	compatible = "qcom,pineapple-mtp", "qcom,pineapple", "qcom,mtp";
        oplus,project-id = <23814>;
        oplus,hw-id = <OPLUS_T0 OPLUS_EVT1 OPLUS_EVT2 OPLUS_DVT1 OPLUS_DVT2 OPLUS_PVT1>;
};
