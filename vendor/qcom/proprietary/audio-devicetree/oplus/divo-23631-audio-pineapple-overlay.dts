/dts-v1/;
/plugin/;
#include <dt-bindings/oplus/hw-id.h>
#include "../pineapple-audio-mtp.dts"
#include "pineapple-audio-overlay-common.dtsi"
#include "divo-23631-audio-pineapple-overlay.dtsi"

/ {
    model = "Qualcomm Technologies, Inc. Pineapple MTP,corvette";

    oplus,project-id = <23631 24672>;
};
