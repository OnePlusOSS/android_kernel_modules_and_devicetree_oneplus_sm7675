/dts-v1/;
/plugin/;
#include <dt-bindings/oplus/hw-id.h>
#include "../pineapple-audio-mtp.dts"
#include "pineapple-audio-overlay-common.dtsi"
#include "giulia-23851-audio-pineapple-overlay.dtsi"

/ {
    model = "Qualcomm Technologies, Inc. Pineapple MTP,giulia";

    oplus,project-id = <23851 23867>;
};
