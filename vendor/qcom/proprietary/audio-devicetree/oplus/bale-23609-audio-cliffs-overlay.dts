/dts-v1/;
/plugin/;
#include <dt-bindings/oplus/hw-id.h>
#include "../cliffs7-audio-mtp.dts"
#include "cliffs-audio-overlay-common.dtsi"
#include "bale-23609-audio-cliffs-overlay.dtsi"

/ {
    model = "Qualcomm Technologies, Inc. Cliffs MTP,bale";

    oplus,project-id = <23609 23678>;
};