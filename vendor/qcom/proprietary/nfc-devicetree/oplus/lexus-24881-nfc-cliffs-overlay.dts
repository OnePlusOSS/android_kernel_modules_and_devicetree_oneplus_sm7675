/dts-v1/;
/plugin/;
#include <dt-bindings/oplus/hw-id.h>
#include "lexus-24881-nfc-cliffs-overlay.dtsi"

/ {
    model = "Qualcomm Technologies, Inc. Cliffs MTP,lexus";
    oplus,project-id = <24881 24882>;
};