/dts-v1/;
/plugin/;

#include <dt-bindings/oplus/hw-id.h>
#include "caihong-23926-bt-pineapple-overlay.dtsi"

/ {
	model = "Qualcomm Technologies, Inc. Pineapple SoCs";
	compatible = "qcom,pineapple", "qcom,pineapplep";
	qcom,msm-id = <557 0x10000>, <577 0x10000>, <557 0x20000>, <577 0x20000>;
	qcom,board-id = <0 0>;

	oplus,project-id = <23926 23927 23976 23978>;
};
