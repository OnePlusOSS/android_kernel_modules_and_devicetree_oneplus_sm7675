## vendor/qcom/opensource/display-drivers/oplus/common/trackpoint/Kconfig
```kconfig
config OPLUS_TRACKPOINT_REPORT
  tristate "Oplus Trackpoint Report"
  default n
  help
    define this config to init Oplus Trackpoint Report
```

## vendor/qcom/opensource/graphics-kernel/oplus_sync_fence/Kconfig
```kconfig
config OPLUS_SYNC_FENCE
	bool "Enable oplus sync fence"
	help
	  Enable sync_fence driver
```
