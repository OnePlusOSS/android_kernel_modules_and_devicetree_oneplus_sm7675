## vendor/oplus/kernel/audio/codecs/frsm_i2ca_v5.2.2/Kconfig
```kconfig
config SND_SOC_FS181X
	tristate "FourSemi Analog speaker amplifier"
	depends on I2C
	help
	  Config of FourSemi Analog speaker amplifier.
```

## vendor/oplus/kernel/cpu/Kconfig
```kconfig
# SPDX-License-Identifier: GPL-2.0-only
# Copyright (C) 2018-2022 Oplus. All rights reserved.

source "$(KCONFIG_EXT_PREFIX)kernel/oplus_cpu/cpufreq_health/Kconfig"
source "$(KCONFIG_EXT_PREFIX)kernel/oplus_cpu/cpufreq_bouncing/Kconfig"
source "$(KCONFIG_EXT_PREFIX)kernel/oplus_cpu/sched/Kconfig"
source "$(KCONFIG_EXT_PREFIX)kernel/oplus_cpu/uad/Kconfig"
source "$(KCONFIG_EXT_PREFIX)kernel/oplus_cpu/oplus_slc/Kconfig"
source "$(KCONFIG_EXT_PREFIX)kernel/oplus_cpu/oplus_omrg/Kconfig"
source "$(KCONFIG_EXT_PREFIX)kernel/oplus_cpu/oplus_overload/Kconfig"
source "$(KCONFIG_EXT_PREFIX)kernel/oplus_cpu/waker_identify/Kconfig"
source "$(KCONFIG_EXT_PREFIX)kernel/oplus_cpu/oplus_game/Kconfig"
```

## vendor/oplus/kernel/cpu/oplus_game/Kconfig
```kconfig
config OPLUS_FEATURE_GAME_ENABLE
	bool "enable game features by chipset"
	default n
	help
	  use this macro to enable game feature by chipset.

config OPLUS_FEATURE_CPU_GAME
	tristate "OPLUS GAME module specific"
	default n
	help
	  oplus game module. Features from oplus game team can be added here.
```

## vendor/oplus/kernel/cpu/oplus_slc/Kconfig
```kconfig
# SPDX-License-Identifier: GPL-2.0-only

config OPLUS_FEATURE_SLC
  tristate "oplus slc driver"
    default n
    help
      arrange slc policy.
```

## vendor/oplus/kernel/device_info/magnetic_cover/Kconfig
```kconfig
config CONFIG_OPLUS_MAGENTIC_COVER
    tristate "hall ic support"
    default n
    help
        Say Y here if you want to enable the feature.

config CONFIG_OPLUS_MAGENTIC_COVER_MAIN
    tristate "magentic cover support"
    default n
    help
        Say Y here if you want to enable the feature.
```

## vendor/oplus/kernel/device_info/magnetic_cover/magtransfer/Kconfig
```kconfig
config OPLUS_MAGCVR_NOTIFY
    tristate "magcvr notify"
    help
      Say Y here if you have touchscreen notify build into driver.
      Say M here if you have touchscreen notify as module.
```

## vendor/oplus/kernel/device_info/oplus_fpga/fpga_monitor/Kconfig
```kconfig
config OPLUS_FPGA_MONITOR
    tristate "oplus fpga monitor"
    help
        Say Y here if want to add fw monitor driver for the built-in oplus fpga monitor.
        If unsure, say N.
        To compile this driver as a module, choose M here: the
        module will be called oplus_fpga_monitor.
```

## vendor/oplus/kernel/device_info/oplus_fpga/fpga_notify/Kconfig
```kconfig
config OPLUS_FPGA_NOTIFY
    tristate "fpga noity"
    help
      Say Y here if you have fpga notify build into driver.
      Say M here if you have fpga notify as module.
```

## vendor/oplus/kernel/device_info/oplus_fpga/fpga_power/Kconfig
```kconfig
config OPLUS_FPGA_POWER
    tristate "oplus fpga monitor"
    help
        Say Y here if want to add fw monitor driver for the built-in oplus fpga power.
        If unsure, say N.
        To compile this driver as a module, choose M here: the
        module will be called oplus_fpga_power.
```

## vendor/oplus/kernel/device_info/oplus_fpga/fpga_upgrade/Kconfig
```kconfig
config OPLUS_FPGA_UPGRADE
    tristate "oplus fpga update"
    help
        Say Y here if want to add fw update driver for the built-in oplus fpga update.
        If unsure, say N.
        To compile this driver as a module, choose M here: the
        module will be called oplus_fpga_update.
```

## vendor/oplus/kernel/dfr/common/kp_freeze_detect/Kconfig
```kconfig
# SPDX-License-Identifier: GPL-2.0-only
# Copyright (C) 2018-2020 Oplus. All rights reserved.
config OPLUS_FEATURE_KP_FREEZE_DETECT
	tristate "Key process freeze detect"
	default n
	help
            define this config to enable KP_FREEZE_DETECT.
```

## vendor/oplus/kernel/ipc/vipthread/Kconfig
```kconfig
# SPDX-License-Identifier: GPL-2.0-only
# Copyright (C) 2013-2023 Oplus. All rights reserved.

config ANDROID_BINDER_IPC_VIP_THREAD
	tristate "Android Binder IPC VIP THREAD POLICY"
	default n
	help
	  This feature extend binder vip thread policy.
	  Binder vip thread policy checks enable a vip thread for special rpc
```

## vendor/oplus/kernel/mm/mm_osvelte/Kconfig
```kconfig
config OPLUS_FEATURE_MM_OSVELTE
	tristate "osvelte driver"
	default n
	help
	  This driver used for memory debugging.

config OPLUS_FEATURE_MM_OSVELTE_DBG
	tristate "osvelte driver"
	default n
	help
	  This driver used for memory debugging.

config OPLUS_FEATURE_MM_EZRECLAIMD
	bool "Enable ezreclaimd reclaim pages in background"
	default n
	depends on OPLUS_FEATURE_MM_OSVELTE
```

## vendor/oplus/kernel/power/freeze_process/Kconfig
```kconfig
config OPLUS_FEATURE_FREEZE_PROCESS_HOOK
	tristate "config to freeze process hook"
	default n
	help
	  This selects to hook try_to_freeze_tasks()
```

## vendor/oplus/kernel/power/power_hook/Kconfig
```kconfig
config OPLUS_FEATURE_POWER_HOOK
	tristate "config to power hook feature"
	default n
	help
	  This selects to config power hook feature

config OPLUS_FEATURE_IRQ_WAKEUP_HOOK
	tristate "config to hook no suspend irq from s2idle"
	default n
	help
	  This selects to hook no suspend irq which triggered from s2idle

config OPLUS_FEATURE_ALARMTIMER_HOOK
	tristate "config to alarmtimer hook"
	default n
	help
	  This selects to hook alarmtimer

config OPLUS_FEATURE_NETLINK_HOOK
	tristate "config to alarmtimer hook"
	default n
	help
	  This selects to hook netlink wakeupsource
```

## vendor/oplus/kernel/power/rpmh/Kconfig
```kconfig
config OPLUS_FEATURE_RPMH_DECOUPLING
	tristate "config to decouping rpmh statistics"
	default m
	help
	  This selects to decouping rpmh statistics

config OPLUS_RPMH_MTK
	tristate "config to enable rpmh platform rpmh statistics"
	default m
	help
	  This selects to enable rpmh platform rpmh statistics
```

## vendor/oplus/kernel/power/standby_netlink/Kconfig
```kconfig
config OPLUS_FEATURE_STANDBY_NETLINK
	tristate "config to standby netlink channel"
	default n
	help
	  This selects to config standby netlink channel
```

## vendor/oplus/kernel/storage/Kconfig
```kconfig
config OPLUS_FEATURE_STORAGE_IO_METRICS
	tristate "config storage io metrics"
	default y
	help
	  The function of this module is to collect various metrics on the IO path


config OPLUS_FEATURE_STORAGE_IOLATENCY_STATS
    tristate "config oplus_bsp_storage_io_metrics"
    default y
    help
      define this config to compile oplus_bsp_storage_io_metrics for device register
source "drivers/soc/oplus/storage/common/fmonitor/Kconfig"
```

## vendor/oplus/kernel/storage/common/io_metrics/Kconfig
```kconfig
config OPLUS_FEATURE_STORAGE_IO_METRICS_QCOM
  tristate "config oplus_bsp_storage_io_metrics"
  help
    define this config to compile oplus_bsp_storage_io_metrics for device register

config OPLUS_FEATURE_STORAGE_IO_METRICS_MTK
  tristate "config oplus_bsp_storage_io_metrics"
  help
    define this config to compile oplus_bsp_storage_io_metrics for device register

config OPLUS_FEATURE_STORAGE_IO_METRICS_DEBUG
  tristate "config oplus_bsp_storage_io_metrics"
  help
    define this config to compile oplus_bsp_storage_io_metrics for device register

config OPLUS_FEATURE_STORAGE_IO_METRICS
  tristate "config oplus_bsp_storage_io_metrics"
  help
    define this config to compile oplus_bsp_storage_io_metrics for device register
```

## vendor/oplus/kernel/storage/storage_feature_in_module/Kconfig
```kconfig
source "drivers/soc/oplus/storage/common/storage_log/Kconfig"
source "drivers/soc/oplus/storage/common/oplus_uprobe/Kconfig"
source "drivers/soc/oplus/storage/common/ufs_oplus_dbg/Kconfig"
source "drivers/soc/oplus/storage/common/oplus_f2fslog_storage/Kconfig"
source "drivers/soc/oplus/storage/common/wq_dynamic_priority/Kconfig"
```

## vendor/oplus/kernel/storage/storage_feature_in_module/common/oplus_f2fslog_storage/Kconfig
```kconfig
config OPLUS_F2FSLOG_STORAGE
    tristate "f2fs log storage"
    default n
    help
      define this config to enable f2fs log storage.
```

## vendor/oplus/kernel/storage/storage_feature_in_module/common/ufs_oplus_dbg/Kconfig
```kconfig
config OPLUS_UFS_DRIVER
  tristate "config oplus ufs driver"
  help
    define this config to compile ufs-oplus-dbg for device register

config OPLUS_QCOM_UFS_DRIVER
  tristate "config oplus qcom ufs driver"
  help
    define this config to compile ufs-qcom-oplus-dbg for device register
```

## vendor/oplus/kernel/touchpanel/oplus_touchscreen_v2/Focal/ft3419u/Kconfig
```kconfig
config TOUCHPANEL_FOCAL_FT3419U
	tristate "TP focal ft3419u IC enable or not for OPLUS"
	help
	Say Y to enable driver for Touchpanel using Focal FT3518
	Say M to enable driver for Touchpanel using Focal FT3518 as module
```

## vendor/oplus/kernel/touchpanel/oplus_touchscreen_v2/Novatek/NT36528_noflash/Kconfig
```kconfig
config TOUCHPANEL_NOVA_NT36528_NOFLASH
#	default y
	tristate "TP nova nt36528 IC enable or not for OPLUS"
	help
	Say Y to enable driver for Touchpanel useing nova nt36528
	Say O to enable driver for Touchpanel useing nova nt36528 as module
```

## vendor/oplus/kernel/touchpanel/oplus_touchscreen_v2/Novatek/NT36532C/Kconfig
```kconfig
config TOUCHPANEL_NOVA_NT36532C
#	default y
	tristate "TP nova nt36532c IC enable or not for OPLUS"
	help
	Say Y to enable driver for Touchpanel useing nova nt36532c
	Say O to enable driver for Touchpanel useing nova nt36532c as module
```
