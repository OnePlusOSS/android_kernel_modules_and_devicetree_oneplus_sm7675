## vendor/oplus/kernel/touchpanel/oplus_touchscreen_v2/Novatek/NT36536_noflash/Kconfig
```kconfig
config TOUCHPANEL_NOVA_NT36536_NOFLASH
#	default y
	tristate "TP nova nt36536 IC enable or not for OPLUS"
	help
	Say Y to enable driver for Touchpanel useing nova nt36536
	Say O to enable driver for Touchpanel useing nova nt36536 as module
```

## vendor/oplus/kernel/tp/hbp/hbp/chips/goodix/gt99x6/Kconfig
```kconfig
#
# Goodix Touchscreen driver configuration
#

config TOUCHSCREEN_GTS
    tristate "Goodix Touchscreen"
    default n
    help
      Say Y here if you have Goodix touch panel.
      If unsure, say N.
```

## vendor/oplus/kernel/tp/hbp/hbp/chips/synaptics/s3910/Kconfig
```kconfig
#
# Synaptics Touchscreen driver configuration
#

config TOUCHSCREEN_HBP_SYNA_S3910
    tristate "Synaptics Hbp Touchscreen"
    default n
    help
      Say Y here if you have Synaptics hbp touch panel.

      If unsure, say N.
```

## vendor/oplus/kernel/vibrator/oplus_haptic/Kconfig
```kconfig
config OPLUS_HAPTIC_COMMON
	tristate "OPLUS haptic module"
	help
	  Say Y here if you have haptic build into driver.
	  Say M here if you have haptic as module.

config HAPTIC_FEEDBACK
	tristate "Haptic feedback for awinic aw8697 series"
	depends on I2C
	help
	  This option enables support for aw8697 series Haptic Driver.

config AW_HAPTIC
    tristate "Haptic driver for awinic aw8697 series"
    depends on I2C
    help
      This option enables support for aw8697 series Haptic Driver.

config SIH_HAPTIC
    tristate "SI Vibrator driver for sih6887"
    depends on I2C
    help
      This option enables support for sih6887 series Haptic Driver.

config OPLUS_VIBRATOR_GKI_ENABLE
    tristate "vibrator compatibility"
    help
      This option enables support for vibrator compatibility.
```

## vendor/oplus/kernel/vibrator/si_haptic/Kconfig
```kconfig
config SIH_VIBRATOR
    tristate "SI Vibrator driver for sih6887"
    depends on I2C
    help
      This option enables support for sih6887 series Haptic Driver.

config OPLUS_VIBRATOR_GKI_ENABLE
    tristate "vibrator compatibility"
    help
      This option enables support for vibrator compatibility.
```

## vendor/oplus/sensor/kernel/oplus_consumer_ir/Kconfig
```kconfig
config OPLUS_SENSOR_CONSUMER_IR_CORE
	tristate "sensor consumer ir config for core"
	help
	  To compile this driver as a module, set m in kernel build config
	  module will be called oplus_ir_core.
config OPLUS_SENSOR_CONSUMER_IR_QC
	tristate "sensor consumer ir config for qcom"
	help
	  To compile this driver as a module, set m in kernel build config
	  module will be called oplus_ir_spi.
config OPLUS_SENSOR_CONSUMER_IR_MTK
	tristate "sensor consumer ir config for MediaTek"
	help
	  To compile this driver as a module, set m in kernel build config
	  module will be called oplus_ir_pwm.
config OPLUS_SENSOR_IR_USE_WL2868C
	bool "use ldo WL2868"
	help
	  To use ldo WL2868, added flag for new kernels as previous flag not available.
```

## vendor/oplus/sensor/kernel/oplus_sensor_devinfo/Kconfig
```kconfig
config OPLUS_SENSOR_MTK68XX
	bool "for MediaTek 68xx"
	default n
	help
	  It support 68xx.
config OPLUS_SENSOR_FB_MTK
	tristate "sensor feedback config for qcom"
	help
	  To compile this driver as a module, set M in kernel build config
	  module will be called sensor_feedback.
config OPLUS_SENSOR_DEVINFO_V2
  tristate "support oplus sensor device information for new kernel"
  default n
  help
    define this config to support oplus sensor devinfo
```

## vendor/oplus/sensor/kernel/oplus_trace_sensor/Kconfig
```kconfig
config OPLUS_FEATURE_TRACE_SENSOR
	tristate "sensor subsystem crash trace"
	help
	  When this option is enabled, the crash of sensor subsystem
	  will be recorded and trigger log collection.
```

## vendor/oplus/sensor/kernel/oplus_virtual_sensor/Kconfig
```kconfig
config OPLUS_FEATURE_SENSOR_ALGORITHM
	bool "oplus vritual sensor config"
	default n
config OPLUS_VIRTUAL_SENSOR
  tristate "support oplus virtual sensor"
  default n
  help
    define this config to support oplus virtual sensor
```

## vendor/oplus/sensor/kernel/oplus_virtual_sensor/platform/sensor_cmd/Kconfig
```kconfig
config OPLUS_SENSOR_CMD
  tristate "support sensor cmd"
  default n
  help
    define this config to support sensor cmd
```

## vendor/oplus/sensor/kernel/oplus_virtual_sensor/platform/sensor_device/Kconfig
```kconfig
config OPLUS_SENSOR_ATTR
  tristate "support sensor attr"
  default n
  help
    define this config to support sensor attr
```

## vendor/oplus/sensor/kernel/oplus_virtual_sensor/platform/sensor_event/Kconfig
```kconfig
config OPLUS_SENSOR_EVENT
  tristate "support sensor event"
  default n
  help
    define this config to support sensor event
```

## vendor/oplus/sensor/kernel/oplus_virtual_sensor/sensors/ambiente_proxhub/Kconfig
```kconfig
config OPLUS_FEATURE_AMBIENTE_PROX
	tristate "ambiente_proxhub for MediaTek package"
	default n
```

## vendor/oplus/sensor/kernel/oplus_virtual_sensor/sensors/back_tap_detecthub/Kconfig
```kconfig
config OPLUS_FEATURE_BACK_TAP_DETECT
    tristate "back_tap_detect for MediaTek package"
    default n
```

## vendor/oplus/sensor/kernel/oplus_virtual_sensor/sensors/elevator_detecthub/Kconfig
```kconfig
config OPLUS_FEATURE_ELEVATOR_DETECT
    tristate "elevator_detect for MediaTek package"
    default n
```

## vendor/oplus/sensor/kernel/oplus_virtual_sensor/sensors/fp_displayhub/Kconfig
```kconfig
config OPLUS_FEATURE_FP_DISPLAY
	tristate "fp_displayhub for MediaTek package"
	default n
```

## vendor/oplus/sensor/kernel/oplus_virtual_sensor/sensors/gesture_proxhub/Kconfig
```kconfig
config OPLUS_FEATURE_GESTURE_PROX
	tristate "gesture_proxhub for MediaTek package"
	default n
```

## vendor/oplus/sensor/kernel/oplus_virtual_sensor/sensors/lay_detecthub/Kconfig
```kconfig
config OPLUS_FEATURE_LAY_DETECT
	tristate "lay_detecthub for MediaTek package"
	default n
```

## vendor/oplus/sensor/kernel/oplus_virtual_sensor/sensors/lux_aodhub/Kconfig
```kconfig
config OPLUS_FEATURE_LUX_AOD
	tristate "lux_aodhub for MediaTek package"
	default n
```

## vendor/oplus/sensor/kernel/oplus_virtual_sensor/sensors/oplus_activity_recognitionhub/Kconfig
```kconfig
config OPLUS_FEATURE_ACTIVITY_RECOGNITION
    tristate "oplus_activity_recognition for MediaTek package"
    default n
```

## vendor/oplus/sensor/kernel/oplus_virtual_sensor/sensors/palm_detecthub/Kconfig
```kconfig
config OPLUS_FEATURE_PALM_DETECT
	tristate "palm_detecthub for MediaTek package"
	default n
```

## vendor/oplus/sensor/kernel/oplus_virtual_sensor/sensors/pedo_minutehub/Kconfig
```kconfig
config OPLUS_FEATURE_PEDO_MINUTE
	tristate "pedo_minutehub for MediaTek package"
	default n
```

## vendor/oplus/sensor/kernel/oplus_virtual_sensor/sensors/phone_proxhub/Kconfig
```kconfig
config OPLUS_FEATURE_PHONE_PROX
	tristate "phone_proxhub for MediaTek package"
	default n
```

## vendor/oplus/sensor/kernel/oplus_virtual_sensor/sensors/pickup_detecthub/Kconfig
```kconfig
config OPLUS_FEATURE_PICKUP_DETECT
	tristate "pickup_detecthub for MediaTek package"
	default n
```

## vendor/oplus/sensor/kernel/oplus_virtual_sensor/sensors/rotation_detecthub/Kconfig
```kconfig
config OPLUS_FEATURE_ROTATION_DETECT
    tristate "rotation_detect for MediaTek package"
    default n
```
