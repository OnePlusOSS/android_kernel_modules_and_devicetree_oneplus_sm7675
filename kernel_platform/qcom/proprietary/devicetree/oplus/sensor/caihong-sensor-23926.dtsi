/**********************************************************************************
* Copyright (c)  2022-2024  Guangdong oplus Mobile Comm Corp., Ltd
* Description: oplus sensor dtsi
*
* Version: 1.0
* Date: 2022-07-04
*
* ------------------------------ Revision History: --------------------------------
* <version>         <date>        <author>                <desc>
***********************************************************************************/
&soc {
	//#ifdef OPLUS_FEATURE_SENSOR_SMEM
	sensor_fb: sensor_fb {
		compatible = "oplus,sensor-feedback";
		master-id  = <3>;
		smem-id    = <608>;
	};

	oplus_sensor {
		compatible = "oplus,sensor-devinfo";
	};
	//#endif /*OPLUS_FEATURE_SENSOR_SMEM*/
};


