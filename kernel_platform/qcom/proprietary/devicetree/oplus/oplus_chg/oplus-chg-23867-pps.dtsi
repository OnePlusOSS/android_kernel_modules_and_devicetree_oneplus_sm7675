&oplus_cpa {
	compatible = "oplus,cpa";
	oplus,protocol_list = <CHG_PROTOCOL_VOOC 80
				CHG_PROTOCOL_PD  18
				CHG_PROTOCOL_QC  18>;
	oplus,default_protocol_list = <CHG_PROTOCOL_PD
					CHG_PROTOCOL_VOOC>;
	oplus,cpa_region_cfg_power_pps {
		oplus,region_id = /bits/ 8 <0x44 0xA7>;
		oplus,protocol_list = <CHG_PROTOCOL_VOOC 80
					CHG_PROTOCOL_PPS 55
					CHG_PROTOCOL_PD  18
					CHG_PROTOCOL_QC  18>;
		oplus,default_protocol_list = <CHG_PROTOCOL_PD
						CHG_PROTOCOL_PPS
						CHG_PROTOCOL_VOOC>;
	};
};
